// FloodGuard R2 — RAM-ONLY exact production-overlay-body witness.
// Generated by generate_exact_overlay_host.py, never built for a device.
// The actual LittleFS 2.5.0 C implementation is SHA-pinned by CI.
// No Wi-Fi, sensor, Firebase, ACK, alarm, gate, device flash or durability proof.
#include <cassert>
#include <cstddef>
#include <cstdint>
#include <cstdio>
#include <cstring>
#include "lfs.h"

enum { BLOCK_SIZE=512, BLOCK_COUNT=64, IO_SIZE=16 };
struct MemoryDisk {
  uint8_t bytes[BLOCK_COUNT][BLOCK_SIZE];
  unsigned reads, progs, erases, syncs;
  bool fail_reads, fail_progs, fail_syncs;
  bool torn_prog_once, trigger_nested_once;
  unsigned torn_faults;
};
static MemoryDisk disk;
static void (*nested_attempt)() = nullptr;

static bool region(lfs_block_t b,lfs_off_t o,lfs_size_t n) {
  return b < BLOCK_COUNT && o <= BLOCK_SIZE && n <= BLOCK_SIZE-o &&
         o%IO_SIZE == 0 && n%IO_SIZE == 0;
}
static int disk_read(const lfs_config *c,lfs_block_t b,lfs_off_t o,
                     void *dst,lfs_size_t n) {
  MemoryDisk *d = static_cast<MemoryDisk*>(c->context);
  ++d->reads;
  if (!region(b,o,n) || d->fail_reads) return LFS_ERR_IO;
  std::memcpy(dst,&d->bytes[b][o],n);
  return 0;
}
static int disk_prog(const lfs_config *c,lfs_block_t b,lfs_off_t o,
                     const void *src,lfs_size_t n) {
  MemoryDisk *d = static_cast<MemoryDisk*>(c->context);
  ++d->progs;
  if (!region(b,o,n) || d->fail_progs) return LFS_ERR_IO;
  if (d->trigger_nested_once) {
    d->trigger_nested_once=false;
    assert(nested_attempt != nullptr);
    nested_attempt();
  }
  const uint8_t *v = static_cast<const uint8_t*>(src);
  if (d->torn_prog_once) {
    d->torn_prog_once=false;
    ++d->torn_faults;
    // A simulated interruption can program a PREFIX before reporting I/O.
    const lfs_size_t prefix = n/2;
    for (lfs_size_t i=0;i<prefix;++i)
      if ((d->bytes[b][o+i]&v[i])!=v[i]) return LFS_ERR_IO;
    for (lfs_size_t i=0;i<prefix;++i) d->bytes[b][o+i]&=v[i];
    return LFS_ERR_IO;
  }
  for (lfs_size_t i=0;i<n;++i)
    if ((d->bytes[b][o+i]&v[i])!=v[i]) return LFS_ERR_IO;
  for (lfs_size_t i=0;i<n;++i) d->bytes[b][o+i]&=v[i];
  return 0;
}
static int disk_erase(const lfs_config *c,lfs_block_t b) {
  MemoryDisk *d = static_cast<MemoryDisk*>(c->context);
  ++d->erases;
  if (b>=BLOCK_COUNT) return LFS_ERR_IO;
  std::memset(d->bytes[b],0xff,BLOCK_SIZE);
  return 0;
}
static int disk_sync(const lfs_config *c) {
  MemoryDisk *d = static_cast<MemoryDisk*>(c->context);
  ++d->syncs;
  return d->fail_syncs ? LFS_ERR_IO : 0;
}
static lfs_config cfg;
static void fresh_disk() {
  std::memset(&disk,0,sizeof(disk));
  std::memset(disk.bytes,0xff,sizeof(disk.bytes));
  std::memset(&cfg,0,sizeof(cfg));
  cfg.context=&disk;
  cfg.read=disk_read;
  cfg.prog=disk_prog;
  cfg.erase=disk_erase;
  cfg.sync=disk_sync;
  cfg.read_size=IO_SIZE;
  cfg.prog_size=IO_SIZE;
  cfg.block_size=BLOCK_SIZE;
  cfg.block_count=BLOCK_COUNT;
  cfg.block_cycles=100;
  cfg.cache_size=64;
  cfg.lookahead_size=16;
}

namespace fs {
enum class ExclusiveLocalResult : uint8_t {
  Unsupported, InvalidInput, AlreadyExists, CommitUncertain, LocalBytesMatched
};
enum class JournalSlotObservation : uint8_t {
  Unsupported, InvalidInput, PresentUnverified,
  AbsenceUnverified, StorageUncertain
};
}
namespace littlefs_impl {
using fs::ExclusiveLocalResult;
using fs::JournalSlotObservation;
class LittleFSImpl {
 public:
  lfs_t _lfs = {};
  bool _mounted = false;
  bool _fgExclusiveQuarantined = false;
  bool _fgExclusiveBusy = false;
  static bool pathValid(const char* p) {
    return p != nullptr && std::strlen(p) < LFS_NAME_MAX;
  }
  ExclusiveLocalResult createExclusiveLocal(
      const char* path,const uint8_t* bytes,size_t length);
  JournalSlotObservation probeJournalSlot(const char* path);
  bool mountExisting() {
    if (_mounted) return false;
    std::memset(&_lfs,0,sizeof(_lfs));
    _mounted = (lfs_mount(&_lfs,&cfg)==0);
    return _mounted;
  }
  bool initializeNew() {
    if (_mounted) return false;
    std::memset(&_lfs,0,sizeof(_lfs));
    if (lfs_format(&_lfs,&cfg) != 0) return false;
    return mountExisting();
  }
  void stop() {
    if (_mounted) {
      assert(lfs_unmount(&_lfs)==0);
      _mounted=false;
    }
  }
};

// EXACT_IMPL_FROM_PINNED_OVERLAY
// EXACT_PROBE_FROM_PINNED_OVERLAY

} // namespace littlefs_impl

using littlefs_impl::LittleFSImpl;
using fs::ExclusiveLocalResult;
using fs::JournalSlotObservation;
static uint8_t fixture[220];
static void setup_fixture() {
  for(size_t i=0;i<sizeof(fixture);++i)
    fixture[i] = static_cast<uint8_t>((i*37+11)&255);
}
static void expect_exact(lfs_t *f,const char *path) {
  lfs_file_t handle = {};
  assert(lfs_file_open(f,&handle,path,LFS_O_RDONLY)==0);
  assert(lfs_file_size(f,&handle)==static_cast<lfs_soff_t>(sizeof(fixture)));
  uint8_t received[sizeof(fixture)]={};
  assert(lfs_file_read(f,&handle,received,sizeof(received))==
         static_cast<lfs_ssize_t>(sizeof(received)));
  assert(std::memcmp(received,fixture,sizeof(fixture))==0);
  assert(lfs_file_close(f,&handle)==0);
}
static void blank_volume() {
  fresh_disk();
  setup_fixture();
  nested_attempt = nullptr;
}

static void case_unmounted_and_invalid() {
  blank_volume();
  LittleFSImpl fs;
  assert(fs.createExclusiveLocal("/fgq2_0.bin",fixture,sizeof(fixture))==
         ExclusiveLocalResult::Unsupported);
  assert(fs.initializeNew());
  unsigned p=disk.progs, e=disk.erases;
  const char *bad[]={"", "/", "/nested/file.bin", "relative.bin"};
  for (const char *s:bad)
    assert(fs.createExclusiveLocal(s,fixture,sizeof(fixture))==
           ExclusiveLocalResult::InvalidInput);
  assert(fs.createExclusiveLocal(nullptr,fixture,sizeof(fixture))==
         ExclusiveLocalResult::InvalidInput);
  assert(fs.createExclusiveLocal("/fgq2_0.bin",nullptr,sizeof(fixture))==
         ExclusiveLocalResult::InvalidInput);
  assert(fs.createExclusiveLocal("/fgq2_0.bin",fixture,0)==
         ExclusiveLocalResult::InvalidInput);
  assert(fs.createExclusiveLocal("/fgq2_0.bin",fixture,1039)==
         ExclusiveLocalResult::InvalidInput);
  assert(disk.progs==p && disk.erases==e);
  assert(!fs._fgExclusiveQuarantined);
  fs.stop();
}
static void case_exact_slot_allowlist() {
  blank_volume();
  LittleFSImpl fs;
  assert(fs.initializeNew());
  // Reject root-level arbitrary names, extensions and case variants before
  // any low-level LittleFS I/O or metadata updates.
  const char *bad[]={
      "/other.bin", "/fgq2_8.bin", "/fgq2_0.bin.bak",
      "/FGQ2_0.bin", "/fgq2_00.bin", "/fgq2_1.dat"};
  const unsigned p=disk.progs,e=disk.erases,r=disk.reads;
  for (const char *path:bad)
    assert(fs.createExclusiveLocal(path,fixture,sizeof(fixture))==
           ExclusiveLocalResult::InvalidInput);
  assert(disk.progs==p && disk.erases==e && disk.reads==r);
  assert(!fs._fgExclusiveQuarantined);
  fs.stop();
}

static void case_exact_new_duplicate_and_remount() {
  blank_volume();
  LittleFSImpl fs;
  assert(fs.initializeNew());
  assert(fs.createExclusiveLocal("/fgq2_0.bin",fixture,sizeof(fixture))==
         ExclusiveLocalResult::LocalBytesMatched);
  expect_exact(&fs._lfs,"/fgq2_0.bin");
  unsigned p=disk.progs, e=disk.erases;
  assert(fs.createExclusiveLocal("/fgq2_0.bin",fixture,sizeof(fixture))==
         ExclusiveLocalResult::AlreadyExists);
  assert(disk.progs==p && disk.erases==e);
  expect_exact(&fs._lfs,"/fgq2_0.bin");
  fs.stop();
  LittleFSImpl remount;
  assert(remount.mountExisting());
  p=disk.progs; e=disk.erases;
  assert(remount.createExclusiveLocal("/fgq2_0.bin",fixture,sizeof(fixture))==
         ExclusiveLocalResult::AlreadyExists);
  assert(disk.progs==p && disk.erases==e);
  expect_exact(&remount._lfs,"/fgq2_0.bin");
  remount.stop();
}
static void case_write_fault_quarantines_and_blocks_retry() {
  blank_volume();
  LittleFSImpl fs;
  assert(fs.initializeNew());
  assert(fs.createExclusiveLocal("/fgq2_0.bin",fixture,sizeof(fixture))==
         ExclusiveLocalResult::LocalBytesMatched);
  disk.fail_progs=true;
  const auto fault=fs.createExclusiveLocal("/fgq2_1.bin",fixture,sizeof(fixture));
  assert(fault==ExclusiveLocalResult::CommitUncertain);
  assert(fs._fgExclusiveQuarantined);
  disk.fail_progs=false;
  unsigned p=disk.progs, e=disk.erases, rd=disk.reads;
  assert(fs.createExclusiveLocal("/fgq2_2.bin",fixture,sizeof(fixture))==
         ExclusiveLocalResult::CommitUncertain);
  assert(disk.progs==p && disk.erases==e && disk.reads==rd);
  // A known preexisting record cannot be discarded after a fault.
  // Inspecting it here is a host diagnostic, not automated retry policy.
  fs.stop();
  LittleFSImpl remount;
  assert(remount.mountExisting());
  expect_exact(&remount._lfs,"/fgq2_0.bin");
  remount.stop();
}
static void case_sync_fault_quarantines() {
  blank_volume();
  LittleFSImpl fs;
  assert(fs.initializeNew());
  disk.fail_syncs=true;
  const auto fault=fs.createExclusiveLocal("/fgq2_0.bin",fixture,sizeof(fixture));
  assert(fault==ExclusiveLocalResult::CommitUncertain);
  assert(fs._fgExclusiveQuarantined);
  disk.fail_syncs=false;
  unsigned p=disk.progs, rd=disk.reads;
  assert(fs.createExclusiveLocal("/fgq2_1.bin",fixture,sizeof(fixture))==
         ExclusiveLocalResult::CommitUncertain);
  assert(disk.progs==p && disk.reads==rd);
  fs.stop();
}
static void case_read_fault_quarantines() {
  blank_volume();
  LittleFSImpl fs;
  assert(fs.initializeNew());
  disk.fail_reads=true;
  const auto fault=fs.createExclusiveLocal("/fgq2_0.bin",fixture,sizeof(fixture));
  assert(fault==ExclusiveLocalResult::CommitUncertain);
  assert(fs._fgExclusiveQuarantined);
  disk.fail_reads=false;
  unsigned p=disk.progs, rd=disk.reads;
  assert(fs.createExclusiveLocal("/fgq2_0.bin",fixture,sizeof(fixture))==
         ExclusiveLocalResult::CommitUncertain);
  assert(disk.progs==p && disk.reads==rd);
  fs.stop();
}

static void case_torn_metadata_program_quarantines() {
  blank_volume();
  LittleFSImpl fs;
  assert(fs.initializeNew());
  assert(fs.createExclusiveLocal("/fgq2_0.bin",fixture,sizeof(fixture))==
         ExclusiveLocalResult::LocalBytesMatched);
  disk.torn_prog_once=true;
  const auto fault=fs.createExclusiveLocal("/fgq2_1.bin",fixture,sizeof(fixture));
  assert(fault==ExclusiveLocalResult::CommitUncertain);
  assert(disk.torn_faults==1);
  assert(fs._fgExclusiveQuarantined);
  disk.torn_prog_once=false;
  const unsigned p=disk.progs,e=disk.erases,r=disk.reads;
  assert(fs.createExclusiveLocal("/fgq2_2.bin",fixture,sizeof(fixture))==
         ExclusiveLocalResult::CommitUncertain);
  assert(disk.progs==p && disk.erases==e && disk.reads==r);
  // The old bytes are still retained in the simulated volume, but no
  // recovery or new writes are authorized by this uncertain mount.
  // A later fresh mount may itself fail; never autoformat on that basis.
  fs.stop();
  LittleFSImpl audit;
  if (audit.mountExisting()) {
    expect_exact(&audit._lfs,"/fgq2_0.bin");
    audit.stop();
  }
}
static LittleFSImpl* nested_owner = nullptr;
static bool nested_rejected = false;
static void inject_nested_attempt() {
  assert(nested_owner != nullptr);
  nested_rejected =
      nested_owner->createExclusiveLocal("/fgq2_2.bin",fixture,sizeof(fixture))==
      ExclusiveLocalResult::CommitUncertain;
}
static void case_reentrant_writer_refused() {
  blank_volume();
  LittleFSImpl fs;
  assert(fs.initializeNew());
  assert(fs.createExclusiveLocal("/fgq2_0.bin",fixture,sizeof(fixture))==
         ExclusiveLocalResult::LocalBytesMatched);
  nested_owner=&fs;
  nested_rejected=false;
  nested_attempt=inject_nested_attempt;
  disk.trigger_nested_once=true;
  const auto outer=fs.createExclusiveLocal("/fgq2_1.bin",fixture,sizeof(fixture));
  assert(nested_rejected);
  assert(outer==ExclusiveLocalResult::CommitUncertain);
  assert(fs._fgExclusiveQuarantined);
  assert(!fs._fgExclusiveBusy);
  nested_attempt=nullptr;
  nested_owner=nullptr;
  const unsigned p=disk.progs,e=disk.erases,r=disk.reads;
  assert(fs.createExclusiveLocal("/fgq2_3.bin",fixture,sizeof(fixture))==
         ExclusiveLocalResult::CommitUncertain);
  assert(disk.progs==p && disk.erases==e && disk.reads==r);
  fs.stop();
}

static void case_probe_unmounted_invalid() {
  blank_volume();
  LittleFSImpl fs;
  assert(fs.probeJournalSlot("/fgq2_0.bin")==JournalSlotObservation::Unsupported);
  assert(fs.initializeNew());
  const unsigned p=disk.progs,e=disk.erases,r=disk.reads;
  assert(fs.probeJournalSlot(nullptr)==JournalSlotObservation::InvalidInput);
  assert(fs.probeJournalSlot("/outside.bin")==JournalSlotObservation::InvalidInput);
  assert(fs.probeJournalSlot("/fgq2_8.bin")==JournalSlotObservation::InvalidInput);
  assert(disk.progs==p && disk.erases==e && disk.reads==r);
  assert(!fs._fgExclusiveQuarantined);
  fs.stop();
}
static void case_probe_present_is_only_metadata() {
  blank_volume();
  LittleFSImpl fs;
  assert(fs.initializeNew());
  assert(fs.createExclusiveLocal("/fgq2_0.bin",fixture,sizeof(fixture))==
         ExclusiveLocalResult::LocalBytesMatched);
  const unsigned p=disk.progs,e=disk.erases;
  assert(fs.probeJournalSlot("/fgq2_0.bin")==
         JournalSlotObservation::PresentUnverified);
  assert(disk.progs==p && disk.erases==e);
  assert(!fs._fgExclusiveQuarantined);
  fs.stop();
}
static void case_probe_absence_quarantines_even_if_no_io_error() {
  blank_volume();
  LittleFSImpl fs;
  assert(fs.initializeNew());
  assert(fs.probeJournalSlot("/fgq2_1.bin")==
         JournalSlotObservation::AbsenceUnverified);
  assert(fs._fgExclusiveQuarantined);
  const unsigned p=disk.progs,e=disk.erases,r=disk.reads;
  assert(fs.probeJournalSlot("/fgq2_1.bin")==
         JournalSlotObservation::StorageUncertain);
  assert(fs.createExclusiveLocal("/fgq2_1.bin",fixture,sizeof(fixture))==
         ExclusiveLocalResult::CommitUncertain);
  assert(disk.progs==p && disk.erases==e && disk.reads==r);
  fs.stop();
}
static void case_probe_after_torn_program_is_denied_without_io() {
  blank_volume();
  LittleFSImpl fs;
  assert(fs.initializeNew());
  assert(fs.createExclusiveLocal("/fgq2_0.bin",fixture,sizeof(fixture))==
         ExclusiveLocalResult::LocalBytesMatched);
  disk.torn_prog_once=true;
  assert(fs.createExclusiveLocal("/fgq2_1.bin",fixture,sizeof(fixture))==
         ExclusiveLocalResult::CommitUncertain);
  assert(fs._fgExclusiveQuarantined);
  const unsigned p=disk.progs,e=disk.erases,r=disk.reads;
  assert(fs.probeJournalSlot("/fgq2_0.bin")==
         JournalSlotObservation::StorageUncertain);
  assert(disk.progs==p && disk.erases==e && disk.reads==r);
  fs.stop();
}

int main() {
  case_unmounted_and_invalid();
  case_exact_slot_allowlist();
  case_exact_new_duplicate_and_remount();
  case_write_fault_quarantines_and_blocks_retry();
  case_sync_fault_quarantines();
  case_read_fault_quarantines();
  case_torn_metadata_program_quarantines();
  case_reentrant_writer_refused();
  case_probe_unmounted_invalid();
  case_probe_present_is_only_metadata();
  case_probe_absence_quarantines_even_if_no_io_error();
  case_probe_after_torn_program_is_denied_without_io();
  std::puts("PASS exact patched ESP8266 LittleFS core: 8 write + 4 typed probe RAM scenarios; no flash");
  return 0;
}
